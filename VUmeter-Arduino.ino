#include <Arduino.h>
#include <U8g2lib.h>
#include <SPI.h>
#include <Wire.h>
U8G2_SSD1322_NHD_256X64_F_4W_HW_SPI u8g2(U8G2_R0, /* cs=*/ 10, /* dc=*/ 9, /* reset=*/ 8);  // Enable U8G2_16BIT in u8g2.h

int analogInputL = A0;                 // analog input for outside audio source
int analogInputR = A2;
int hMeter1 = 65;                      // horizontal center for needle animation
int hMeter2 = 193;                      // horizontal center for needle animation
int vMeter = 85;                      // vertical center for needle animation (outside of dislay limits)
int rMeter = 80;                      // length of needle animation or arch of needle travel

const int sampleWindow = 15;          // sample window width in mS (50 mS = 20Hz)
unsigned int sample1;
unsigned int sample2;
float PeakRight = 80;                             // start needle fall max to min on start
  float PeakLeft = 80;                             // start needle fall max to min on start
  float fallTimeRight;          // needle fallspeed
  float fallTimeLeft;          // needle fallspeed
  float riseTimeRight;          // needle fallspeed
  float riseTimeLeft;          // needle fallspeed

const uint8_t test4[] PROGMEM = {
0x00, 0x00, 0x00, 0x00, 0x00, 0x00, 0x00, 0x00, 0x00, 0x00, 0x00, 0x00, 0x00, 0x00, 0x10, 0x10, 
0x10, 0x10, 0x10, 0x00, 0x00, 0x00, 0x00, 0x00, 0x00, 0x00, 0x00, 0x00, 0x00, 0x00, 0x00, 0x00, 
0x00, 0x00, 0x00, 0x00, 0x00, 0x00, 0x00, 0x00, 0x00, 0x00, 0x00, 0x00, 0x00, 0x00, 0x00, 0x00, 
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0x00, 0x00, 0x00, 0x00, 0x00, 0x00, 0x00, 0x00, 0x00, 0x00, 0x00, 0x00, 0x00, 0x00, 0x00, 0x00  
};

void setup(void) {
  pinMode(analogInputL, INPUT);
  pinMode(analogInputR, INPUT);
  u8g2.begin();
  u8g2.setBusClock(8000000); //8MHz SPI
  //Serial.begin(9200);
}

void loop(void) {
  unsigned long startMillis = millis();                    // start of sample window
  float PeaktoPeak1 = 0;                             // peak-to-peak level
  unsigned int SignalMax1 = 0;
  unsigned int SignalMin1 = 1024;
  float PeaktoPeak2 = 0;                             // peak-to-peak level
  unsigned int SignalMax2 = 0;
  unsigned int SignalMin2 = 1024;
  
  while ( millis() - startMillis < sampleWindow ){

    sample1 = analogRead(analogInputL);
    sample2 = analogRead(analogInputR);
    if (sample1 < 1024) {

      if (sample1 > SignalMax1){

        SignalMax1 = sample1;                                // saves just the max levels
      }

      else if (sample1 < SignalMin1){

        SignalMin1 = sample1;                                // saves just the min levels
      }
    }
    if (sample2 < 1024) {

      if (sample2 > SignalMax2){

        SignalMax2 = sample2;                                // saves just the max levels
      }

      else if (sample2 < SignalMin2){

        SignalMin2 = sample2;                                // saves just the min levels
      }
    }
  }

  PeaktoPeak1 = SignalMax1 - SignalMin1;                      // max - min = peak-peak amplitude
  PeaktoPeak2 = SignalMax2 - SignalMin2;                      // max - min = peak-peak amplitude
  Serial.println("start");
  Serial.println(PeakLeft);
  if (PeaktoPeak1 > PeakLeft){
    riseTimeLeft=((PeaktoPeak1-PeakLeft)/10);
    PeakLeft = PeakLeft+riseTimeLeft;
  }else if(PeaktoPeak1 <= PeakLeft){
    fallTimeLeft = ((PeakLeft - PeaktoPeak1) / 15);
    PeakLeft = PeakLeft-fallTimeLeft;
  }
  if (PeaktoPeak2 > PeakRight){
    riseTimeRight=((PeaktoPeak2-PeakRight)/10);
    PeakRight = PeakRight+riseTimeRight;
  }else if(PeaktoPeak2 <= PeakRight){
    fallTimeRight = ((PeakRight - PeaktoPeak2) / 15);
    PeakRight = PeakRight-fallTimeRight;
  }

  float MeterValue1 = PeakLeft;              // convert volts to arrow information sensitivity 
  float MeterValue2 = PeakRight;              // convert volts to arrow information sensitivity 
  MeterValue1 = MeterValue1 - 34;
  MeterValue2 = MeterValue2 - 34;
  u8g2.clearBuffer();                   //clear the internal memory
  memcpy_P(u8g2.getBufferPtr(),test4, 2048);
  int al1 = (hMeter1 + (sin(MeterValue1 / 57.296) * rMeter)); // meter needle horizontal coordinate
  int al2 = (vMeter - (cos(MeterValue1 / 57.296) * rMeter)); // meter needle vertical coordinate
  int ar1 = (hMeter2 + (sin(MeterValue2 / 57.296) * rMeter)); // meter needle horizontal coordinate
  int ar2 = (vMeter - (cos(MeterValue2 / 57.296) * rMeter)); // meter needle vertical coordinate
  u8g2.drawLine(al1, al2, hMeter1-2, vMeter);         // draws needle
  u8g2.drawLine(al1, al2, hMeter1+2, vMeter);         // draws needle
  u8g2.drawLine(ar1, ar2, hMeter2-2, vMeter);         // draws needle
  u8g2.drawLine(ar1, ar2, hMeter2+2, vMeter);         // draws needle
  u8g2.sendBuffer();
}
